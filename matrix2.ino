#include <bitswap.h>
#include <chipsets.h>
#include <color.h>
#include <colorpalettes.h>
#include <colorutils.h>
#include <controller.h>
#include <cpp_compat.h>
#include <dmx.h>
#include <FastLED.h>
#include <fastled_config.h>
#include <fastled_delay.h>
#include <fastled_progmem.h>
#include <fastpin.h>
#include <fastspi.h>
#include <fastspi_bitbang.h>
#include <fastspi_dma.h>
#include <fastspi_nop.h>
#include <fastspi_ref.h>
#include <fastspi_types.h>
#include <hsv2rgb.h>
#include <led_sysdefs.h>
#include <lib8tion.h>
#include <noise.h>
#include <pixelset.h>
#include <pixeltypes.h>
#include <platforms.h>
#include <power_mgt.h>

/*********************
   Max7219_pinDIN = 8;
  Max7219_pinCS   = 9;
  Max7219_pinCLK = 10;
 **************************/


#include <FastLED.h>
#include <Arduino.h>
#include "Max7219.c"
#include "music_note.c"

#define COLOR_LED_NUMS  4
#define COLOR_PIN  6

//画大心形
const byte sprite[40][8] = {//每行作为一种图案，每列表示某个数据寄存器的值
  {0x00, 0x00, 0x00, 0x10, 0x00, 0x00, 0x00, 0x00},
  {0x00, 0x00, 0x00, 0x18, 0x00, 0x00, 0x00, 0x00},
  {0x00, 0x00, 0x00, 0x18, 0x08, 0x00, 0x00, 0x00},
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  {0x00, 0x66, 0xFF, 0xFF, 0xFF, 0x7E, 0x3C, 0x18},
  //{0x00,0x00,0x24,0x7E,0x7E,0x3C,0x18,0x00},
  //{0x00,0x66,0xFF,0xFF,0xFF,0x7E,0x3C,0x18 },
};
//大心闪动
const byte flash[2][8] =
{
  {0x00, 0x66, 0xFF, 0xFF, 0xFF, 0x7E, 0x3C, 0x18},
  {0x00, 0x00, 0x00, 0x00, 0x00, 0x00, 0x00, 0x00}
};
//流水灯
const byte Water_Light[25][8] = {
  {0x00, 0x00, 0x20, 0x00, 0x00, 0x00, 0x00, 0x00},
  {0x00, 0x00, 0x20, 0x40, 0x00, 0x00, 0x00, 0x00},
  {0x00, 0x00, 0x20, 0x40, 0x40, 0x00, 0x00, 0x00},
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  {0x00, 0x00, 0x24, 0x7E, 0x7E, 0x3C, 0x18, 0x00},
};

//生日歌
const int Birthday[] =
{
  G, G, A, G, CC, B,
  G, G, A, G, DD, CC,
  G, G, GG, EE, CC, B, A,
  FF, FF, EE, CC, DD, CC,
};
//生日歌节拍
const char Duration[] =
{
  1, 1, 2, 2, 2, 3,
  1, 1, 2, 2, 2, 3,
  1, 1, 2, 2, 2, 1, 3,
  1, 1, 2, 2, 2, 3,
};

//
const byte Color[16][3] =
{
  {0x10, 0x10, 0x00},
  {0x40, 0x10, 0x10},
  {0x60, 0x90, 0x50},
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  {0xFF, 0xFF, 0xFF},
};

byte Buzzer = 3;
byte len = 0;

byte LEDL = 4, LEDR = 5;
int BRIGHTNESS = 255;
CRGB Cled[COLOR_LED_NUMS];

void setup()
{
  pinMode(LEDL, OUTPUT);
  pinMode(LEDR, OUTPUT);
  //pinMode(LEDC,OUTPUT);
  pinMode(Buzzer, OUTPUT);
  len = sizeof(Birthday) / sizeof(Birthday[0]);

  Init_MAX7219();
  digitalWrite(LEDL, LOW);
  digitalWrite(LEDR, LOW);

  FastLED.addLeds<WS2812, COLOR_PIN, GRB>(Cled, COLOR_LED_NUMS);
  FastLED.setBrightness(BRIGHTNESS);
  FastLED.clear();

  for (byte i = 0; i < 8; i++)
  {
    Write_Max7219(i + 1, 0);
  }
  for (byte j = 0; j < 40; j++)
  {
    for (byte i = 0; i < 8; i++)
    {
      Write_Max7219(i + 1, sprite[j][i]);
    }
    delay(200);
  }
}
int All_time = 0, Music_time = 0;
byte water_light_row = 0, Color_Cnt = 0;

void loop()
{
  All_time ++;
  if (All_time < 30)
  {
    for (byte i = 0; i < 2; i ++)
    {
      for (byte j = 0; j < 8; j ++)
      {
        Write_Max7219(j + 1, flash[i][j]);
      }
      if (All_time < 15)
        delay(1500 / All_time);
      else
        delay(1500 / 15);
    }
  }
  else if (All_time > 30)
  {
    if (Music_time <= 6)
    {
      Music_time++;
      for (int i = 0; i < len; i++) {
        tone(Buzzer, Birthday[i]);
        delay(240 * Duration[i]);
        noTone(Buzzer);
        for (byte water_light_col = 0; water_light_col < 8; water_light_col ++)
        {
          Write_Max7219(water_light_col + 1, Water_Light[water_light_row][water_light_col]);
        }
        water_light_row ++;
        if (water_light_row == 25)
          water_light_row = 0;
        color_light();
        delay(70);
      }
    }
    else if (Music_time > 6)
    {
      for (byte water_light_col = 0; water_light_col < 8; water_light_col ++)
      {
        Write_Max7219(water_light_col + 1, Water_Light[24][water_light_col]);
      }
    }
    if (Music_time >= 1)
    { //LED lighting
      digitalWrite(LEDL, HIGH);
      digitalWrite(LEDR, HIGH);
    }
    color_light();
    delay(500);
  }
}

void color_light()
{
  for (byte i = 0; i < 4; i ++)
  {
    Cled[i] = CRGB(Color[i + Color_Cnt * 4][0], Color[i + Color_Cnt * 4][1], Color[i + Color_Cnt * 4][2]);
    FastLED.show();
    //delay(300);
  }
  Color_Cnt ++;
  if (Color_Cnt == 4)
    Color_Cnt = 0;
}
